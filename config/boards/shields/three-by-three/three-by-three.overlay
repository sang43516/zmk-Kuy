/ {
    key_matrix {
        compatible = "zmk,matrix-transform";
        label = "KEY_MATRIX";
        rows = <3>;
        columns = <3>;
        row-gpios = <&gpio0 8 GPIO_ACTIVE_LOW>,
                    <&gpio0 17 GPIO_ACTIVE_LOW>,
                    <&gpio0 20 GPIO_ACTIVE_LOW>;
        col-gpios = <&gpio0 22 GPIO_ACTIVE_LOW>,
                    <&gpio0 24 GPIO_ACTIVE_LOW>,
                    <&gpio1 0 GPIO_ACTIVE_LOW>;
    };
};
